AUTOSAR XML (schema 00048)
package /services
  service interface BatteryService
    methods:
      operation GetVoltage
        arg battery_id: type=uint8, direction=IN
        arg voltage: type=float64, direction=OUT
      operation SetChargeLimit
        arg limit: type=float64, direction=IN
    events:
      data VoltageChanged: type=float64
package /types
  impl type BatteryStatus: category=STRUCTURE
    element voltage: implementation-data-type=float64
    element current: implementation-data-type=float64
    element charging: implementation-data-type=boolean
package /deployment
  someip service interface deployment BatteryServiceDeployment: service-interface=BatteryService, service-interface-id=16400
    someip method deployment GetVoltage: method-id=1
    someip method deployment SetChargeLimit: method-id=2
    someip event deployment VoltageChanged: event-id=32769
    someip event group VoltageEvents: event-group-id=1
