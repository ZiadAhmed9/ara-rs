AUTOSAR XML (schema 00051)
package /services
  service interface BatteryService
    methods:
      operation GetVoltage
        arg battery_id: type=uint8, direction=IN
        arg voltage: type=float64, direction=OUT
      operation SetChargeLimit
        arg limit: type=float64, direction=IN
    events:
      data VoltageChanged: type=float64
package /types
  impl type BatteryStatus: category=STRUCTURE
    element voltage: implementation-data-type=float64
    element current: implementation-data-type=float64
    element charging: implementation-data-type=boolean
