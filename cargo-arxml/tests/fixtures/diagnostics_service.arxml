AUTOSAR XML (schema 00048)
package /services
  service interface DiagnosticsService
    methods:
      4 x operation:
        ReadDtc
          arg dtc_id: type=uint32, direction=IN
          arg snapshot: type=DtcSnapshot, direction=OUT
        ClearDtc
          arg dtc_id: type=uint32, direction=IN
        ReadEcuIdentification
          arg info: type=EcuInfo, direction=OUT
        ReadDataByIdentifier
          arg identifier: type=uint16, direction=IN
          arg sub_function: type=uint8, direction=IN
          arg data: type=DataRecord, direction=OUT
    events:
      data DtcStatusChanged: type=uint32
      data SessionChanged: type=uint8
package /types
  impl type DtcSnapshot: category=STRUCTURE
    4 x element, all with category=TYPE_REFERENCE:
      dtc_id: implementation-data-type=uint32
      status_byte: implementation-data-type=uint8
      timestamp: implementation-data-type=uint64
      occurrence_count: implementation-data-type=uint16
  impl type EcuInfo: category=STRUCTURE
    4 x element, all with category=TYPE_REFERENCE:
      serial_number: implementation-data-type=uint32
      hardware_version: implementation-data-type=uint16
      software_version: implementation-data-type=uint16
      uptime_seconds: implementation-data-type=uint64
  impl type DataRecord: category=STRUCTURE
    element identifier: implementation-data-type=uint16
    element length: implementation-data-type=uint16
    element value: implementation-data-type=uint32
package /deployment
  someip service interface deployment DiagnosticsServiceDeployment: service-interface=DiagnosticsService, service-interface-id=20480
    4 x someip method deployment:
      ReadDtc: method-id=1
      ClearDtc: method-id=2
      ReadEcuIdentification: method-id=3
      ReadDataByIdentifier: method-id=4
    someip event deployment DtcStatusChanged: event-id=32769
    someip event deployment SessionChanged: event-id=32770
    someip event group DiagEvents: event-group-id=1
    someip event group SessionEvents: event-group-id=2
