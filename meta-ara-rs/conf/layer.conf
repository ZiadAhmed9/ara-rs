## meta-ara-rs/conf/layer.conf
```bitbake
# Layer configuration for meta-ara-rs
# Provides Rust Adaptive AUTOSAR crates: ara-com, ara-com-someip, cargo-arxml

BBPATH .= ":${LAYERDIR}"

BBFILES += " \
    ${LAYERDIR}/recipes-*/*/*.bb \
    ${LAYERDIR}/recipes-*/*/*.bbappend \
"

BBFILE_COLLECTIONS += "ara-rs"
BBFILE_PATTERN_ara-rs = "^${LAYERDIR}/"
BBFILE_PRIORITY_ara-rs = "6"

LAYERDEPENDS_ara-rs = "core meta-rust-bin"
LAYERSERIES_COMPAT_ara-rs = "scarthgap styhead"
```
